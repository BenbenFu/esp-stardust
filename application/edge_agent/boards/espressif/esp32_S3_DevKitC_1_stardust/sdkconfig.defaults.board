## application/edge_agent/boards/espressif/esp32_S3_DevKitC_1_stardust/sdkconfig.defaults.board
```kconfig
# sdkconfig.defaults for ESP32-S3-DevKitC-1 N16R8 (Stardust)
#
# Flash: 16MB QIO 80MHz
# PSRAM: 8MB Octal 80MHz

CONFIG_ESP_DEFAULT_CPU_FREQ_MHZ_240=y
CONFIG_ESPTOOLPY_FLASHMODE_QIO=y
CONFIG_ESPTOOLPY_FLASHFREQ_80M=y

# N16R8: 16MB Flash
CONFIG_ESPTOOLPY_FLASHSIZE_16MB=y

# 8MB PSRAM (Octal)
CONFIG_SPIRAM=y
CONFIG_SPIRAM_MODE_OCT=y
CONFIG_SPIRAM_SPEED_80M=y

# Enable Lua LCD module (for future OLED support via Lua scripts)
CONFIG_APP_CLAW_LUA_MODULE_LCD=y
```

## components/claw_capabilities/cap_diary/Kconfig
```kconfig
menu "CLAW Capability: Diary"

    config CLAW_CAP_DIARY_SCHEDULE_HOUR
        int "Diary generation hour (0-23)"
        depends on APP_CLAW_CAP_DIARY
        range 0 23
        default 23
        help
            Hour of day to trigger diary generation. Default 23:00.

    config CLAW_CAP_DIARY_MAX_RETRIES
        int "Max retry count per diary"
        depends on APP_CLAW_CAP_DIARY
        range 1 10
        default 3
        help
            Max retries for Supabase sync and TF card write.

    config CLAW_CAP_DIARY_DEFAULT_CONTENT
        string "Default diary content (no chat)"
        depends on APP_CLAW_CAP_DIARY
        default "今天星屑在安静地陪伴着Benben，没有对话，但星光依然闪烁。\n\n晚安，好梦。"
        help
            Content used when no conversation is available for the day.

endmenu
```

## components/esp_stardust_sd/Kconfig
```kconfig
menu "ESP Stardust SD Card"

    config STARDUST_SD_ENABLE
        bool "Enable Stardust SD Card support"
        default y
        help
            Enable custom SD card driver and FAT32 filesystem via SPI.
            Uses a hand-written SD block driver compatible with picky TF cards
            that fail with the standard esp_vfs_fat_sdspi stack.

    config STARDUST_SD_SPI_HOST
        int "SPI Host"
        range 1 3
        default 2
        help
            SPI peripheral to use. ESP32-S3 typically uses SPI2_HOST (FSPI).

    config STARDUST_SD_CS_PIN
        int "CS Pin"
        default 10

    config STARDUST_SD_MOSI_PIN
        int "MOSI Pin"
        default 11

    config STARDUST_SD_MISO_PIN
        int "MISO Pin"
        default 17

    config STARDUST_SD_SCK_PIN
        int "SCK Pin"
        default 18

    config STARDUST_SD_MOUNT_POINT
        string "Mount point"
        default "/sdcard"
        help
            VFS mount point for the SD card.

endmenu
```
